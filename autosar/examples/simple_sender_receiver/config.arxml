AUTOSAR XML (schema 4.0)
package /SenderReceiver
  application sw component type Sender
    provide port VehicleData: provided-interface=VehicleDataInterface
  application sw component type Receiver
    require port VehicleData: required-interface=VehicleDataInterface
